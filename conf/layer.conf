## conf/layer.conf
```bitbake
# We have a conf and classes directory, add to BBPATH
BBPATH .= ":${LAYERDIR}"

# We have recipes-* directories, add to BBFILES
BBFILES += "${LAYERDIR}/recipes-*/*/*.bb \
            ${LAYERDIR}/recipes-*/*/*.bbappend \
            ${LAYERDIR}/*/*.bb \
            ${LAYERDIR}/*/*.bbappend"

BBFILE_COLLECTIONS += "meta-autoeth"
BBFILE_PATTERN_meta-autoeth = "^${LAYERDIR}/"
BBFILE_PRIORITY_meta-autoeth = "6"

LAYERDEPENDS_meta-autoeth = "core"
LAYERSERIES_COMPAT_meta-autoeth = "honister"

# PREFERRED_VERSION_linux-raspberrypi = "5.15.%"
```
